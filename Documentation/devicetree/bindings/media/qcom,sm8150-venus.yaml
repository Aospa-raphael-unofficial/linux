## Documentation/devicetree/bindings/media/qcom,sm8150-venus.yaml
```yaml
# SPDX-License-Identifier: (GPL-2.0-only OR BSD-2-Clause)
%YAML 1.2
---
$id: http://devicetree.org/schemas/media/qcom,sm8150-venus.yaml#
$schema: http://devicetree.org/meta-schemas/core.yaml#

title: Qualcomm SM8150 Venus video encoder and decoder

maintainers:
  - snowf14k3 <60956553+snowf14k3@users.noreply.github.com>

description: |
  SM8150 uses IRIS1/VPU5 with HFI4. MVS0 is the video codec island;
  MVS1 is the CVP island and is not a second video codec core.

allOf:
  - $ref: qcom,venus-common.yaml#

properties:
  '#address-cells':
    const: 2

  '#size-cells':
    const: 2

  compatible:
    const: qcom,sm8150-venus

  ranges: true

  dma-ranges:
    maxItems: 1

  clocks:
    maxItems: 7

  clock-names:
    items:
      - const: iface
      - const: vcodec0_bus
      - const: cvp_bus
      - const: core
      - const: vcodec0_core
      - const: cvp_core
      - const: bus

  resets:
    maxItems: 4

  reset-names:
    items:
      - const: bus
      - const: core
      - const: vcodec0
      - const: cvp

  power-domains:
    maxItems: 4

  power-domain-names:
    items:
      - const: venus
      - const: vcodec0
      - const: cvp
      - const: mmcx

  iommus:
    maxItems: 1

  memory-region:
    minItems: 2
    maxItems: 2
    description: Firmware carveout followed by the protected IOVA reservation.

  memory-region-names:
    items:
      - const: firmware
      - const: iova

  interconnects:
    maxItems: 2

  interconnect-names:
    items:
      - const: video-mem
      - const: cpu-cfg

  operating-points-v2: true
  opp-table:
    type: object

  secure-non-pixel:
    type: object
    additionalProperties: false

    properties:
      compatible:
        const: qcom,venus-secure-context

      iommus:
        maxItems: 1

      qcom,secure-vmid:
        $ref: /schemas/types.yaml#/definitions/uint32
        description: Secure world VMID allowed to read the context page tables.
        const: 11

      memory-region:
        maxItems: 1

    required:
      - compatible
      - iommus
      - qcom,secure-vmid
      - memory-region

required:
  - '#address-cells'
  - '#size-cells'
  - compatible
  - ranges
  - dma-ranges
  - resets
  - reset-names
  - power-domain-names
  - iommus
  - memory-region-names
  - interconnects
  - interconnect-names
  - operating-points-v2
  - secure-non-pixel

unevaluatedProperties: false
```

## Documentation/devicetree/bindings/power/supply/qcom,smb1390-charger.yaml
```yaml
# SPDX-License-Identifier: (GPL-2.0-only OR BSD-2-Clause)
%YAML 1.2
---
$id: http://devicetree.org/schemas/power/supply/qcom,smb1390-charger.yaml#
$schema: http://devicetree.org/meta-schemas/core.yaml#

title: Qualcomm SMB1390 Switched-Capacitor Charge Pump

maintainers:
  - Casey Connolly <casey.connolly@linaro.org>

description: |
  The SMB1390 is a switched-capacitor charge pump used as a secondary
  charger alongside PM8150B (and similar) on some Qualcomm SM8150 phones.
  SMB_EN is driven by the primary charger MISC block; SMB_STAT is typically
  wired to a PMIC GPIO.

properties:
  compatible:
    const: qcom,smb1390-charger

  reg:
    maxItems: 1

  interrupts:
    maxItems: 1
    description: SMB_STAT fault / status interrupt (optional)

  qcom,primary-charger:
    $ref: /schemas/types.yaml#/definitions/phandle
    description: Primary charger power-supply node (e.g. PM8150B charger)

  monitored-battery: true

required:
  - compatible
  - reg

allOf:
  - $ref: power-supply.yaml#

additionalProperties: false

examples:
  - |
    #include <dt-bindings/interrupt-controller/irq.h>

    i2c {
      #address-cells = <1>;
      #size-cells = <0>;

      charger@10 {
        compatible = "qcom,smb1390-charger";
        reg = <0x10>;
        interrupt-parent = <&pm8150b_gpios>;
        interrupts = <6 IRQ_TYPE_LEVEL_LOW>;
        qcom,primary-charger = <&pm8150b_charger>;
      };
    };
```
