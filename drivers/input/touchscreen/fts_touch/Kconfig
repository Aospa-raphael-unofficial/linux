## drivers/input/touchscreen/fts_touch/Kconfig
```kconfig
#
# STMicroelectronics TOUCH driver configuration
#

menuconfig TOUCHSCREEN_STM_FTS_DOWNSTREAM
	tristate "STMicroelectronics multitouch touchscreen - FingerTipS (FTM5)"
	select TOUCHSCREEN_HEATMAP
	help
	  Say Y or M here to enable STMicroelectronics (FTM5) touchscreen support.
	  If unsure, say N.
	  To compile this driver as a module, choose M here: the module
	  will be called fts_touch.

if TOUCHSCREEN_STM_FTS_DOWNSTREAM

choice
	prompt "FTS bus interface"
	default TOUCHSCREEN_STM_FTS_DOWNSTREAM_I2C

config TOUCHSCREEN_STM_FTS_DOWNSTREAM_I2C
	bool "I2C interface"
	depends on I2C
	help
	  Select this option if the touchscreen is connected via I2C bus.

config TOUCHSCREEN_STM_FTS_DOWNSTREAM_SPI
	bool "SPI interface"
	depends on SPI_MASTER
	help
	  Select this option if the touchscreen is connected via SPI bus.

endchoice

endif # TOUCHSCREEN_STM_FTS_DOWNSTREAM
```
